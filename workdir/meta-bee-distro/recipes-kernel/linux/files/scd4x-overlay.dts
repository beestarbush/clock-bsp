/dts-v1/;
/plugin/;

/ {
	compatible = "brcm,bcm2835";

	fragment@0 {
		target = <&i2c_arm>;
		__overlay__ {
			#address-cells = <1>;
			#size-cells = <0>;
			status = "okay";

			scd40: scd40@62 {
				compatible = "sensirion,scd40";
				reg = <0x62>;
				status = "okay";
			};
		};
	};
};
