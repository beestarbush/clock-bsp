## workdir/build/conf/bblayers.conf
```bitbake
# POKY_BBLAYERS_CONF_VERSION is increased each time build/conf/bblayers.conf
# changes incompatibly
POKY_BBLAYERS_CONF_VERSION = "2"

BBPATH = "${TOPDIR}"
BBFILES ?= ""

BBLAYERS ?= " \
  /workdir/poky/meta \
  /workdir/poky/meta-poky \
  /workdir/poky/meta-yocto-bsp \
  /workdir/meta-openembedded/meta-oe \
  /workdir/meta-openembedded/meta-python \
  /workdir/meta-openembedded/meta-networking \
  /workdir/meta-raspberrypi \
  /workdir/meta-bee-distro \
  /workdir/meta-qt6 \
  /workdir/meta-rauc \
"
```

## workdir/meta-bee-distro/conf/distro/bee-distro.conf
```bitbake
require conf/distro/poky.conf

DISTRO = "bee-distro"
DISTRO_NAME = "bee-os"
DISTRO_VERSION = "1.0"
DISTRO_CODENAME = "bee"

## Enable wifi
DISTRO_FEATURES:append = " wifi"
DISTRO_FEATURES:append = " opengl"
DISTRO_FEATURES:append = " egl"
DISTRO_FEATURES:append = " glesv2"
DISTRO_FEATURES:append = " udev usrmerge"

DISTRO_FEATURES:remove = " x11 wayland ptest"

## Enable RAUC OTA update support
DISTRO_FEATURES:append = " rauc"

ENABLE_UART = "1"

## Enable systemd
# use systemd as init manager
DISTRO_FEATURES:append = " systemd"
VIRTUAL-RUNTIME_init_manager = "systemd"

# prevent the SysVinit distribution feature from being automatically enabled
DISTRO_FEATURES_BACKFILL_CONSIDERED = "sysvinit"
# remove initscripts from the image altogether
VIRTUAL-RUNTIME_initscripts = ""

hostname:pn-base-files = "${DISTRO_NAME}"
```

## workdir/meta-bee-distro/wic/bee-ab-image.wks
```
# short-description: Create Raspberry Pi 5 A/B OTA SD card image (GPT)
# long-description: Creates a 6-partition GPT SD card image for RPi5 with
# RAUC A/B update support using the native tryboot mechanism.
#
# Partition layout:
#   1 - firmware  (FAT32, 16MB)   autoboot.txt only
#   2 - bootA     (FAT32, 256MB)  kernel, DTBs, overlays, config.txt, cmdline.txt
#   3 - bootB     (FAT32, 256MB)  empty on initial flash, populated by first RAUC update
#   4 - rootfsA   (ext4,  4GB)    active rootfs (read-only)
#   5 - rootfsB   (ext4,  4GB)    inactive rootfs, populated by first RAUC update
#   6 - data      (ext4)          persistent user data, RAUC state

part --source rawcopy --sourceparams="file=firmware.img" --ondisk mmcblk0 --fstype=vfat --label firmware --align 4096 --fixed-size 16M
part /boot --source bootimg-partition --ondisk mmcblk0 --fstype=vfat --label bootA --active --align 4096 --fixed-size 256M
part --ondisk mmcblk0 --fstype=vfat --label bootB --align 4096 --fixed-size 256M
part / --source rootfs --ondisk mmcblk0 --fstype=ext4 --label rootfsA --align 4096 --fixed-size 4G
part --ondisk mmcblk0 --fstype=ext4 --label rootfsB --align 4096 --fixed-size 4G
part /data --ondisk mmcblk0 --fstype=ext4 --label data --align 4096 --fixed-size 16G

bootloader --ptable gpt
```
